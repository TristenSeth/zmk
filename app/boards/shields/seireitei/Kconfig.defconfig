## app/boards/shields/seireitei/Kconfig.defconfig
```kconfig
# Copyright (c) 2021 The ZMK Contributors
# SPDX-License-Identifier: MIT

if SHIELD_SEIREITEI

config ZMK_KEYBOARD_NAME
	default "The Seireitei"

CONFIG_SMK_USB_LOGGING=y
CONFIG_LOG_PROCESS_THREAD_STARTUP_DELAY_MS=8000
endif
```
